## dts/bindings/i2c/nxp,lpi2c.yaml
```yaml
# Copyright (c) 2019, NXP
# SPDX-License-Identifier: Apache-2.0

description: NXP LPI2C controller

compatible: "nxp,lpi2c"

include: [i2c-controller.yaml, pinctrl-device.yaml, reset-device.yaml]

properties:
  reg:
    required: true

  bus-idle-timeout:
    type: int
    description: Bus idle timeout in nanoseconds

  dmas:
    description: |
      Single shared eDMA request for this LPI2C instance (the LPI2C has one
      DMA request line multiplexed between TX and RX; the driver switches
      MDER.TDDE/RDDE between the command/transmit phase and the receive
      phase on the same channel). Specifier: channel, then DMAMUX source.

  dma-names:
    description: |
      Must be "transfer" when dmas is present.

  scl-gpios:
    type: phandle-array
    description: |
      GPIO to which the I2C SCL signal is routed. This is only needed for I2C bus recovery
      support.

  sda-gpios:
    type: phandle-array
    description: |
      GPIO to which the I2C SDA signal is routed. This is only needed for I2C bus recovery
      support.

  recover-bus-on-init:
    type: boolean
    description: |
      Recover the I2C bus during driver initialization, in case
      the I2C bus is held.  Requires scl-gpios and sda-gpios to be
      defined on the same node.
```
